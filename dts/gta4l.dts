// SPDX-License-Identifier: BSD-2-Clause-Patent
//
// Samsung Galaxy Tab A7 10.4 (2020), SM-T505N / gta4l.
//
// The live SM-T505N FDT reports three DRAM banks:
//   0x40000000+0x3e580000, 0x80000000+0x20000000, 0xa0000000+0x60000000,
// with a hole at 0x7e580000..0x80000000. Format 2's ADT generator requires one
// contiguous range, so this 3 GiB unit uses 0x40000000+0xc0000000. That range
// includes the hole and is not a claim that the physical map is contiguous.
// The largest contiguous free run after the live and firmware reservations is
// 2 GiB at 0x80000000, so board.toml requests that as the DarwinBoot window.
/dts-v1/;
/include/ "sm6115.dtsi"

/ {
    model = "Samsung Galaxy Tab A7 10.4 (2020)";
    compatible = "samsung,gta4l", "qcom,sm6115";

    memory@40000000 {
        device_type = "memory";
        // Single ADT range; see the file header for the three live banks.
        reg = <0 0x40000000 0 0xc0000000>;
    };

    reserved-memory {
        #address-cells = <2>;
        #size-cells = <2>;
        ranges;

        framebuffer@5c000000 {
            reg = <0 0x5c000000 0 0x00927c00>;
            no-map;
        };
    };
};
